/* Copyright (c) 2015-2016, The Linux Foundation. All rights reserved.
 *
 * This program is free software; you can redistribute it and/or modify
 * it under the terms of the GNU General Public License version 2 and
 * only version 2 as published by the Free Software Foundation.
 *
 * This program is distributed in the hope that it will be useful,
 * but WITHOUT ANY WARRANTY; without even the implied warranty of
 * MERCHANTABILITY or FITNESS FOR A PARTICULAR PURPOSE.  See the
 * GNU General Public License for more details.
 */

qcom,jiade_atl446580_3320mah {
	/* #jiade_atl446580_3320mah_averaged_MasterSlave_May8th2017*/
	qcom,max-voltage-uv = <4400000>;
	qcom,nom-batt-capacity-mah = <3320>;
	qcom,batt-id-kohm = <200>;
	qcom,battery-beta = <3380>;
	qcom,battery-type = "jiade_atl446580_3300mah";
	qcom,fastchg-current-ma = <3300>;
	qcom,fg-cc-cv-threshold-mv = <4390>;
	qcom,chg-rslow-comp-c1 = <3217169>;
	qcom,chg-rslow-comp-c2 = <4774631>;
	qcom,chg-rs-to-rslow = <712516>;
	qcom,chg-rslow-comp-thr = <0xA9>;
	qcom,checksum = <0x32B2>;
	qcom,gui-version = "PMI8950GUI - 2.0.0.16";
	qcom,fg-profile-data = [
		 F1 83 79 7D
		 A0 81 23 7C
		 5D 83 C0 67
		 EE 82 52 8D
		 06 82 BC 99
		 1E BC F8 C3
		 5C 11 04 88
		 F6 7D EF 81
		 69 7C 53 83
		 A7 68 96 7A
		 45 87 1C 82
		 94 9A F8 BD
		 A3 CB 5A 0E
		 41 0D 5B 59
		 14 70 71 FD
		 33 45 55 37
		 8E 3A 00 00
		 17 44 E5 32
		 76 3D 00 00
		 00 00 00 00
		 00 00 00 00
		 30 6A 6E 69
		 83 69 ED 81
		 EC 6D 41 60
		 35 60 2A 7B
		 CF 6C B5 5A
		 71 6D FB C8
		 0B 79 60 42
		 5D A0 71 0C
		 28 00 FF 36
		 F0 11 30 03
		 00 00 00 0C
	];
};
