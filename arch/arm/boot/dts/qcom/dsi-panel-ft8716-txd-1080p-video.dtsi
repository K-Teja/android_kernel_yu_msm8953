/* Copyright (c) 2013, The Linux Foundation. All rights reserved.
 *
 * This program is free software; you can redistribute it and/or modify
 * it under the terms of the GNU General Public License version 2 and
 * only version 2 as published by the Free Software Foundation.
 *
 * This program is distributed in the hope that it will be useful,
 * but WITHOUT ANY WARRANTY; without even the implied warranty of
 * MERCHANTABILITY or FITNESS FOR A PARTICULAR PURPOSE.  See the
 * GNU General Public License for more details.
 */

/*---------------------------------------------------------------------------
 * This file is autogenerated file using gcdb parser. Please do not edit it.
 * Update input XML file to add a new entry or update variable in this file
 * VERSION = "1.0"
 *---------------------------------------------------------------------------*/
&mdss_mdp {
	dsi_ft8716_1080_vid: qcom,mdss_dsi_ft8716_txd_1080p_video {
		qcom,mdss-dsi-panel-name = "ft8716 txd 1080p video mode dsi panel";
		qcom,mdss-dsi-panel-controller = <&mdss_dsi0>;
		qcom,mdss-dsi-panel-type = "dsi_video_mode";
		qcom,mdss-dsi-panel-destination = "display_1";
		qcom,mdss-dsi-panel-framerate = <60>;
		qcom,mdss-dsi-virtual-channel-id = <0>;
		qcom,mdss-dsi-stream = <0>;
		qcom,mdss-dsi-panel-width = <1080>;
		qcom,mdss-dsi-panel-height = <1920>;
		qcom,mdss-dsi-h-front-porch = <30>;
		qcom,mdss-dsi-h-back-porch = <60>;
		qcom,mdss-dsi-h-pulse-width = <8>;
		qcom,mdss-dsi-h-sync-skew = <0>;
		qcom,mdss-dsi-v-back-porch = <20>;
		qcom,mdss-dsi-v-front-porch = <10>;
		qcom,mdss-dsi-v-pulse-width = <4>;
		qcom,mdss-dsi-h-left-border = <0>;
		qcom,mdss-dsi-h-right-border = <0>;
		qcom,mdss-dsi-v-top-border = <0>;
		qcom,mdss-dsi-v-bottom-border = <0>;
		qcom,mdss-dsi-bpp = <24>;
		qcom,mdss-dsi-color-order = "rgb_swap_rgb";
		qcom,mdss-dsi-underflow-color = <0xff>;
		qcom,mdss-dsi-border-color = <0>;
		qcom,mdss-dsi-on-command = [ 15 01 00 00 00 00  02  00    00  
	39 01 00 00 00 00  04  ff    87 16 01  	
	15 01 00 00 00 00  02  00  80  
	39 01 00 00 00 00  03  ff    87 16  
	15 01 00 00 00 00  02  00    80  
	39 01 00 00 00 00  10  C0   00 7E 00 10 07 00 7E 10 10 00 7E 00 10 10 00  
	15 01 00 00 00 00  02  00   A0  
	39 01 00 00 00 00  08  C0  0B 01 05 01 01 1B 07          
	15 01 00 00 00 00  02  00  B4  
	15 01 00 00 00 00  02  C0  00          
	15 01 00 00 00 00  02  00  D0  
	39 01 00 00 00 00  08  C0  0B 01 05 01 01 1B 07          
	15 01 00 00 00 00  02  00  87  
	39 01 00 00 00 00  05  A5  00 07 77 77          
	15 01 00 00 00 00  02  00  80  
	39 01 00 00 00 00  09  C2  82 00 14 0A 81 00 14 0A          
	15 01 00 00 00 00  02  00  B0  
	39 01 00 00 00 00  10  C2   00 01 00 14 00 01 02 00 14 00 82 00 00 14 00          
	15 01 00 00 00 00  02  00  C0  
	39 01 00 00 00 00  06  C2  81 00 00 14 00          
	15 01 00 00 00 00  02  00  DA  
	39 01 00 00 00 00  03  C2  33 33          
	15 01 00 00 00 00  02  00  E0  
	39 01 00 00 00 00  05  C2  05 00 00 03          
	15 01 00 00 00 00  02  00  AA  
	39 01 00 00 00 00  03  C3  9C 9C          
	15 01 00 00 00 00  02  00  D0  
	39 01 00 00 00 00  10 C3   00 02 02 00 00 00 00 01 08 00 00 00 6B 00 09          
	15 01 00 00 00 00  02  00  80  
	39 01 00 00 00 00  07  CE  25 00 A0 00 78 FF         
	15 01 00 00 00 00  02  00  90  
	39 01 00 00 00 00  09  CE  00 49 0E 53 00 49 00 6E          
	15 01 00 00 00 00  02  00  B0  
	39 01 00 00 00 00  07  CE  00 00 60 79 00 60          
	15 01 00 00 00 00  02  00  80  
	39 01 00 00 00 00  0d  CC   01 02 03 06 07 08 09 0A 0B 0C 0D 0E          
	15 01 00 00 00 00  02  00  90  
	39 01 00 00 00 00  0D  CC   01 03 02 09 08 07 06 0E 0D 0C 0B 0A         
	15 01 00 00 00 00  02  00  A0  
	39 01 00 00 00 00  10 CC   1A 1B 1C 1D 1E 1F 18 19 20 21 10 22 22 22 22          
	15 01 00 00 00 00  02  00  B0  
	39 01 00 00 00 00  05  CC  22 22 22 22          
	15 01 00 00 00 00  02  00  80  
	39 01 00 00 00 00  09  CB  00 00 00 00 00 00 00 00          
	15 01 00 00 00 00  02  00  90  
	39 01 00 00 00 00  10  CB   F0 00 00 00 00 00 00 00 00 00 00 00 00 00 00         
	15 01 00 00 00 00  02  00  A0  
	39 01 00 00 00 00  10  CB   F0 F0 F0 50 50 00 00 00 00 FF 00 00 00 00 00          
	15 01 00 00 00 00  02  00  B0  
	39 01 00 00 00 00  03  CB  00 00          
	15 01 00 00 00 00  02  00  C0  
	39 01 00 00 00 00  10  CB   00 05 05 05 05 05 05 05 05 05 05 05 F5 F5 F5          
	15 01 00 00 00 00  02  00  D0  
	39 01 00 00 00 00  10  CB   05 05 05 55 55 05 05 F0 0F 30 05 05 05 05 05          
	15 01 00 00 00 00  02  00  E0  
	39 01 00 00 00 00  03  CB  05 05          
	15 01 00 00 00 00  02  00  F0  
	39 01 00 00 00 00  09  CB  00 00 FF 3F 50 30 03 00          
	15 01 00 00 00 00  02  00  80  
	39 01 00 00 00 00  10  CD   05 07 24 24 24 24 01 03 17 24 12 11 10 0F 0E          
	15 01 00 00 00 00  02  00  90  
	39 01 00 00 00 00  04  CD  0D 24 24          
	15 01 00 00 00 00  02  00  A0  
	39 01 00 00 00 00  10  CD   04 06 24 24 24 13 14 02 24 24 12 11 10 0F 0E         
	15 01 00 00 00 00  02  00  B0  
	39 01 00 00 00 00  04  CD  0D 24 24          
	15 01 00 00 00 00  02  00  A0  
	39 01 00 00 00 00  08  B3  03 04 38 07 80 11 48         
	15 01 00 00 00 00  02  00  86  
	15 01 00 00 00 00  02  B0  0B         
	15 01 00 00 00 00  02  00  80  
	39 01 00 00 00 00  0B  C5  00 C1 DD C4 14 1E 00 55 50 03         
	15 01 00 00 00 00  02  00  90  
	39 01 00 00 00 00  0B  C5  44 24 14 C0 88 00 29 37 55 50         
	15 01 00 00 00 00  02  00  90  	
	39 01 00 00 00 00  05  CF  FF 00 FE 00  	       
	15 01 00 00 00 00  02  00  00  
	39 01 00 00 00 00  03  D8  25 25          
	15 01 00 00 00 00  02  00  00  
	39 01 00 00 00 00  06  D9  80 8F 8F 8F 8F          
	15 01 00 00 00 00  02  00  C1  
	15 01 00 00 00 00  02  C5  44          
	15 01 00 00 00 00  02  00  80  
	15 01 00 00 00 00  02  C4  41    
	15 01 00 00 00 00  02  00  94  
	15 01 00 00 00 00  02  C5  48     
	15 01 00 00 00 00  02  00  95  
	15 01 00 00 00 00  02  C5  00         
	15 01 00 00 00 00  02  00  C0  
	39 01 00 00 00 00  03  C0  01 10          
	15 01 00 00 00 00  02  00  88  
	39 01 00 00 00 00  03  C3  33 33         
	15 01 00 00 00 00  02  00  98  
	39 01 00 00 00 00  03  C3  33 33  	      
	15 01 00 00 00 00  02  00  84  
	39 01 00 00 00 00  02  A5  80      
	15 01 00 00 00 00  02  00  84  
	39 01 00 00 00 00  03  CF  10 A0         
	15 01 00 00 00 00  02  00  00  
	39 01 00 00 00 00  19  E1  00 06 18 2A 38 40 58 62 6C 73 7D 87 6F 65 60 56 45 3A 32 1D 15 0D 05 03       
	15 01 00 00 00 00  02  00  00  
	39 01 00 00 00 00  19  E1  00 06 18 2A 38 40 58 62 6C 73 7D 87 6F 65 60 56 45 3A 32 1D 15 0D 05 03  
	05 01 00 00 78 00 02 11 00
         05 01 00 00 14 00 02 29 00];
		qcom,mdss-dsi-off-command = [05 01 00 00 78 00 02 28 00
			05 01 00 00 96 00 02 10 00];
		qcom,mdss-dsi-on-command-state = "dsi_lp_mode";
		qcom,mdss-dsi-off-command-state = "dsi_lp_mode";
		qcom,mdss-dsi-h-sync-pulse = <1>;
		qcom,mdss-dsi-traffic-mode = "burst_mode";
		qcom,mdss-dsi-lane-map = "lane_map_0123";
		qcom,mdss-dsi-bllp-eof-power-mode;
		qcom,mdss-dsi-bllp-power-mode;
		qcom,mdss-dsi-lp11-init;
		qcom,suspend-ulps-enabled;
		qcom,mdss-dsi-lane-0-state;
		qcom,mdss-dsi-lane-1-state;
		qcom,mdss-dsi-lane-2-state;
		qcom,mdss-dsi-lane-3-state;
		qcom,mdss-dsi-panel-timings = [1D 3E 2A 01 74 76 30 42 32 03 04 00];
		qcom,mdss-dsi-t-clk-post = <0x03>;
		qcom,mdss-dsi-t-clk-pre = <0x28>;
		qcom,mdss-dsi-dma-trigger = "trigger_sw";
		qcom,mdss-dsi-mdp-trigger = "none";
		qcom,mdss-dsi-reset-sequence = <1 1>, <0 5>, <1 50>;
		qcom,esd-check-enabled;
		qcom,mdss-dsi-panel-status-check-mode = "reg_read";
		qcom,mdss-dsi-panel-status-command
			= [06 01 00 01 05 00 02 0A 00];
		qcom,mdss-dsi-panel-status-command-state = "dsi_lp_mode";
		qcom,mdss-dsi-panel-status-read-length = <1>;
		qcom,mdss-dsi-panel-status-value = <0x9C>;
		qcom,mdss-pan-physical-width-dimension = <68>;
		qcom,mdss-pan-physical-height-dimension = <121>;
		qcom,mdss-dsi-bl-min-level = <1>;
		qcom,mdss-dsi-bl-max-level = <4095>;
		qcom,mdss-dsi-bl-pmic-control-type = "bl_ctrl_wled";
	};
};
